// SPDX-License-Identifier: (GPL-2.0 OR MIT)
/*
 * Copyright 2024 Google LLC
 */

/dts-v1/;
#include "mt8186-corsola-veluza.dtsi"

/ {
	model = "Google veluza sku65538/sku65539/sku65540/sku65541/sku65544/
		65545/sku65546 board";
	compatible = "google,veluza-sku65538", "google,veluza-sku65539",
		     "google,veluza-sku65540", "google,veluza-sku65541",
		     "google,veluza-sku65544", "google,veluza-sku65545",
		     "google,veluza-sku65546", "google,veluza",
		     "google,corsola", "mediatek,mt8186";
};

&i2c1 {
	/delete-node/ touchscreen@10;
};

&gpio_keys {
	status = "disabled";
};
