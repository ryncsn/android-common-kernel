## Documentation/devicetree/bindings/thermal/mediatek,virtual-temp.yaml
```yaml
# SPDX-License-Identifier: (GPL-2.0-only OR BSD-2-Clause)
%YAML 1.2
---
$id: http://devicetree.org/schemas/thermal/mediatek.virtual-temp.yaml#
$schema: http://devicetree.org/meta-schemas/core.yaml#

title: MediaTek Virtual Temperature sensor (vtemp)

maintainers:
  - Hsin-Te Yuan <yuanhsinte@google.com>

properties:
  compatible:
    const: mediatek,virtual-temp

  mediatek,tz-names:
    description: The thermal zones to be aggregated

  "#thermal-sensor-cells":
    const: 1

required:
  - compatible
  - mediatek,tz-names
  - "#thermal-sensor-cells"

additionalProperties: false

examples:
  - |
    vtemp: vtemp {
      compatible = "mediatek,virtual-temp";
      #thermal-sensor-cells = <1>;
      mediatek,tz-names = "cpu-little0-thermal",
                          "cpu-little1-thermal",
                          "cpu-little2-thermal",
                          "cpu-little3-thermal",
                          "cpu-big0-thermal",
                          "cpu-big1-thermal",
                          "apu-thermal",
                          "gpu-thermal",
                          "gpu1-thermal",
                          "adsp-thermal",
                          "vdo-thermal",
                          "infra-thermal",
                          "cam1-thermal",
                          "cam2-thermal";
    };
```

## drivers/cma_test/Kconfig
```kconfig
#
# Configuration for the CMA allocation test driver
#
config CMA_ALLOC_TEST
	tristate "CMA allocation test driver"
	default y
	help
	  Driver to test and debug CMA allocations
```

## drivers/soc/mediatek/apusys/Kconfig
```kconfig
# SPDX-License-Identifier: GPL-2.0-only

config MTK_APUSYS_SUPPORT
	tristate "MediaTek APUSYS driver"
	depends on ARM || ARM64
	select REGMAP
	select MAILBOX
	select MTK_APU_MBOX
	select MTK_SCP
	select PM_DEVFREQ
	help
	  Enable Mediatek APUSYS feature for centralize control.
	  Middleware and APU scheduler will control memory,
	  QoS, and normal/deadline command queue in central layer.
	  Support multiple, multicore APU command scheduling and
	  execution in low level driver.
```
